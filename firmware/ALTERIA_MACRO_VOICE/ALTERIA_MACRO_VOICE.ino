/*
  ALTERIA MACRO VOICE 1.0.0
  REV5-2 / Arduino Nano ATmega328P 16 MHz / MCP4822
  Five original oscillator models. No LPG, VCA or output filter.
  CV IN: nominal 1 V/oct. I/O: trigger INPUT, always.
  MODE cycles models. MANUAL and I/O sync or pluck.
  OUT1/OUT2: bipolar audio. Existing ACAL is read only.
*/
#include <Arduino.h>
#include <SPI.h>
#include <EEPROM.h>
#include <avr/pgmspace.h>
#include <util/atomic.h>

#if defined(__AVR__) && (!defined(__AVR_ATmega328P__) || F_CPU != 16000000UL)
#error "ALTERIA MACRO VOICE needs an ATmega328P at 16 MHz."
#endif

const uint16_t AUDIO_RATE=8000;
const uint8_t PIN_IO=2,PIN_CV_LED=3,PIN_MODE=4,PIN_IO_LED=5;
const uint8_t PIN_LED1=6,PIN_CS=10,PIN_LDAC=12;
const uint8_t PIN_CV=A2,PIN_MANUAL=A3;
const uint8_t POTS[3]={A0,A1,A6};
const int16_t CV_IN_ADC_ZERO=0,CV_IN_ADC_PLUS5=1023;

enum Model : uint8_t {FOLD,FM,CHORD,WAVETABLE,KARPLUS,MODEL_COUNT};
struct Button {
  bool raw,stable;
  uint32_t changed;
};
struct AudioParams {
  uint32_t inc[5]; // Root on inc[0]; chord notes on inc[1..4].
  uint16_t stringDelay,stringTap,stringGain;
  int8_t stringAllpass;
  uint8_t stringLength;
  const int8_t *table;
  uint16_t foldRise,foldFall;
  uint8_t model,p1,p2,p3;
};
static AudioParams config;
static uint32_t phase[5];
static volatile bool pendingSync;
static volatile uint16_t frames,hits;
static uint8_t runningModel=MODEL_COUNT;
static int16_t fmPrevious;
static uint8_t p2Now,p3Now;
static uint16_t zeroCode[2]={2048,2048};
static uint16_t posSpan[2]={980,980},negSpan[2]={980,980};
#if !defined(__AVR__)
static uint16_t written[2];
#endif
static uint8_t model=FOLD,sector1,sector2,potSlot;
static uint16_t pots[3];
static uint16_t pitchCv;
static bool ioHigh,cvMoving,ioFlash;
static uint32_t lastPot,lastControl,lastPitchMove,lastHit;
static Button modeButton,manualButton;

// Q32 phase steps at 8 kHz, C1 through C2.
const uint32_t PITCH[13] PROGMEM={17557394UL,18601411UL,19707509UL,20879378UL,22120931UL,23436310UL,24829905UL,26306368UL,27870626UL,29527900UL,31283720UL,33143947UL,35114789UL};
const int8_t SINE[64] PROGMEM={0,9,19,28,37,45,53,61,68,74,80,85,89,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-19,-9};
// Original single-cycle spectra. Bands limit each frame to 12, 6, 3 or 1 partials.
const int8_t WAVES[3][4][4][64] PROGMEM={
  {
    {
      {0,9,19,28,37,45,53,61,68,74,80,85,89,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-19,-9},
      {0,56,90,95,84,75,76,84,88,84,78,76,81,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-90,-56},
      {0,57,91,94,82,73,74,77,76,68,61,59,60,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-91,-57},
      {0,60,93,92,74,60,58,60,57,47,39,36,37,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-93,-60},
    },
    {
      {0,9,19,28,37,45,53,61,68,74,80,85,89,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-19,-9},
      {0,30,56,77,90,96,95,89,82,76,72,71,73,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-56,-30},
      {0,33,62,83,94,96,90,80,70,62,57,56,57,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-62,-33},
      {0,36,66,86,95,94,84,69,55,43,37,35,37,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-66,-36},
    },
    {
      {0,9,19,28,37,45,53,61,68,74,80,85,89,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-19,-9},
      {0,20,39,56,71,82,90,95,96,95,91,86,80,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-39,-20},
      {0,19,38,55,69,81,89,94,96,95,91,85,78,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-38,-19},
      {0,21,40,58,73,84,92,96,95,92,85,77,67,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-40,-21},
    },
    {
      {0,9,19,28,37,45,53,61,68,74,80,85,89,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-19,-9},
      {0,9,19,28,37,45,53,61,68,74,80,85,89,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-19,-9},
      {0,9,19,28,37,45,53,61,68,74,80,85,89,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-19,-9},
      {0,9,19,28,37,45,53,61,68,74,80,85,89,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-19,-9},
    },
  },
  {
    {
      {0,13,25,37,48,58,67,75,81,87,91,93,95,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-25,-13},
      {0,27,52,72,86,94,96,92,85,75,64,54,45,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-52,-27},
      {0,42,75,93,95,84,65,45,31,25,27,34,44,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-75,-42},
      {0,60,93,90,65,41,30,31,33,32,29,29,32,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-93,-60},
    },
    {
      {0,13,25,37,48,58,67,75,81,87,91,93,95,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-25,-13},
      {0,27,52,72,86,94,96,92,85,75,64,54,45,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-52,-27},
      {0,36,67,88,96,92,78,60,41,28,22,25,36,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-67,-36},
      {0,36,67,87,96,92,80,62,44,31,23,22,26,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-67,-36},
    },
    {
      {0,13,25,37,48,58,67,75,81,87,91,93,95,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-25,-13},
      {0,23,45,64,79,89,95,96,92,84,74,61,49,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-45,-23},
      {0,20,40,57,72,84,91,95,96,93,88,81,74,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-40,-20},
      {0,22,43,62,77,88,94,96,93,87,78,68,57,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-43,-22},
    },
    {
      {0,9,19,28,37,45,53,61,68,74,80,85,89,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-19,-9},
      {0,9,19,28,37,45,53,61,68,74,80,85,89,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-19,-9},
      {0,9,19,28,37,45,53,61,68,74,80,85,89,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-19,-9},
      {0,9,19,28,37,45,53,61,68,74,80,85,89,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-19,-9},
    },
  },
  {
    {
      {21,36,48,57,64,67,68,66,63,59,54,50,46,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-13,5},
      {-13,16,42,60,70,71,65,55,43,32,25,21,20,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-62,-41},
      {7,55,88,95,78,45,11,-10,-10,11,43,73,90,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-77,-42},
      {-4,62,89,67,24,-7,-7,17,43,54,46,30,19,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-96,-71},
    },
    {
      {21,36,48,57,64,67,68,66,63,59,54,50,46,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-13,5},
      {-13,16,42,60,70,71,65,55,43,32,25,21,20,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-62,-41},
      {20,47,61,61,50,34,19,10,11,21,36,51,61,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-46,-13},
      {1,25,45,58,65,67,64,59,55,53,52,53,55,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-45,-24},
    },
    {
      {21,36,48,57,64,67,68,66,63,59,54,50,46,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-13,5},
      {9,21,33,43,52,59,65,69,73,75,77,79,80,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-18,-5},
      {8,21,33,43,53,60,67,71,75,78,79,81,81,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-20,-6},
      {8,21,33,44,53,60,66,71,74,77,78,79,80,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-19,-5},
    },
    {
      {0,9,19,28,37,45,53,61,68,74,80,85,89,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-19,-9},
      {0,9,19,28,37,45,53,61,68,74,80,85,89,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-19,-9},
      {0,9,19,28,37,45,53,61,68,74,80,85,89,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-19,-9},
      {0,9,19,28,37,45,53,61,68,74,80,85,89,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-19,-9},
    },
  },
};

// 64 pre-mixed timbres per band: one table read per chord oscillator.
const int8_t CHORD_COLOR[3][64][64] PROGMEM={
  {
    {0,9,19,28,37,45,53,61,68,74,80,85,89,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-19,-9},
    {0,10,20,29,38,45,53,61,68,74,80,85,89,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-20,-10},
    {0,11,21,30,38,46,54,62,68,74,79,84,88,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-21,-11},
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    {0,57,91,94,82,73,74,77,76,68,61,59,60,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-91,-57},
  },
  {
    {0,9,19,28,37,45,53,61,68,74,80,85,89,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-19,-9},
    {0,9,20,29,38,46,54,61,68,74,80,85,88,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-20,-9},
    {0,10,20,30,39,47,54,62,68,74,79,84,88,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-20,-10},
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    {0,33,62,83,94,96,90,80,70,62,57,56,57,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-62,-33},
  },
  {
    {0,9,19,28,37,45,53,61,68,74,80,85,89,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-19,-9},
    {0,9,19,28,38,46,54,62,68,74,80,85,89,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-19,-9},
    {0,9,20,29,38,46,54,62,69,75,80,85,89,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-20,-9},
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    {0,19,38,55,69,81,89,94,96,95,91,85,78,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-38,-19},
  },
};

const uint8_t CHORDS[8][4] PROGMEM={
  {0,3,7,9},{0,4,7,9},{0,2,7,10},{0,5,7,10},
  {0,3,7,10},{0,4,7,11},{0,4,7,10},{0,3,5,10}
};
const uint8_t FM_RATIOS_X2[8] PROGMEM={1,2,3,4,5,6,8,10};

static uint16_t calCrc(const uint8_t *r){
  uint16_t crc=0xffff;
  for(uint8_t i=0;i<19;i++){
    crc^=(uint16_t)r[i]<<8;
    for(uint8_t b=0;b<8;b++)crc=(uint16_t)((crc<<1)^((crc&0x8000)?0x1021:0));
  }
  return crc;
}

static uint16_t readWord(const uint8_t *r){
  return (uint16_t)r[0]|((uint16_t)r[1]<<8);
}

static bool validCal(const uint8_t *r){
  if(r[0]!='A'||r[1]!='C'||r[2]!='A'||r[3]!='L'||r[4]!=1||r[21]!=0xa5
     ||readWord(r+19)!=calCrc(r))return false;
  for(uint8_t c=0;c<2;c++){
    uint16_t z=readWord(r+7+c*2),p=readWord(r+11+c*2),n=readWord(r+15+c*2);
    if(z<1024||z>3072||p>=z-512||n<=z+512||n>4095)return false;
  }
  return true;
}

static void loadCalibration(){
  uint8_t r[2][22];
  for(uint8_t c=0;c<2;c++)for(uint8_t i=0;i<22;i++)r[c][i]=EEPROM.read(256+24*c+i);
  bool a=validCal(r[0]),b=validCal(r[1]);
  if(!a&&!b)return;
  uint16_t diff=(uint16_t)(readWord(r[1]+5)-readWord(r[0]+5));
  uint8_t bank=!a||(b&&diff>0&&diff<32768);
  for(uint8_t c=0;c<2;c++){
    zeroCode[c]=readWord(r[bank]+7+c*2);
    posSpan[c]=(zeroCode[c]-readWord(r[bank]+11+c*2))/2;
    negSpan[c]=(readWord(r[bank]+15+c*2)-zeroCode[c])/2;
  }
}

#if defined(__AVR__)
static void dacWriteRaw(uint8_t ch,uint16_t value){
  uint16_t word=(ch?0x9000U:0x1000U)|(value&4095);
  digitalWrite(PIN_CS,LOW);
  SPI.transfer((uint8_t)(word>>8));
  SPI.transfer((uint8_t)word);
  digitalWrite(PIN_CS,HIGH);
}
#endif

static void writeDac(uint16_t a,uint16_t b){
#if defined(__AVR__)
  dacWriteRaw(0,a);dacWriteRaw(1,b);
  digitalWrite(PIN_LDAC,LOW);
  __builtin_avr_delay_cycles(F_CPU/1000000UL);
  digitalWrite(PIN_LDAC,HIGH);
#else
  written[0]=a;written[1]=b;
#endif
}

static inline uint16_t audioCode(uint8_t c,int16_t v){
  uint16_t span=v>=0?posSpan[c]:negSpan[c];
  uint8_t mag=v>=0?v:-v;
  uint16_t delta=mag*(span>>7)+((mag*(span&127))>>7);
  return v>=0?zeroCode[c]-delta:zeroCode[c]+delta;
}

static inline int16_t boundSample(int16_t v){return v>127?127:v<-127?-127:v;}

static inline int16_t tableSample(const int8_t *table,uint16_t p){
  uint8_t idx=p>>10,frac=p>>2;
  int16_t a=(int8_t)pgm_read_byte(table+idx);
  int16_t delta=(int8_t)pgm_read_byte(table+((idx+1)&63))-a;
  // Unsigned product avoids overflow on 16-bit AVR.
  uint16_t mag=(delta<0?-delta:delta);
  uint16_t v=(mag*frac)>>8;
  return delta<0?a-(int16_t)v:a+(int16_t)v;
}

static inline int16_t mix8(int16_t a,int16_t b,uint8_t amount){
  int16_t d=b-a;
  uint16_t mag=d<0?-d:d;
  uint16_t v=(mag*(uint16_t)amount+128)>>8;
  return d<0?a-(int16_t)v:a+(int16_t)v;
}

static inline int16_t fold(int16_t x){
  uint8_t u=(uint8_t)(x+64);
  return u<128?(int16_t)u-64:191-(int16_t)u;
}

static inline int16_t scanTable(uint16_t p,uint8_t index){
  uint8_t frame=index>>6;
  const int8_t *a=config.table+(uint16_t)frame*64;
  int16_t x=tableSample(a,p);
  if(frame==3||!(index&63))return x;
  return mix8(x,tableSample(a+64,p),(index&63)<<2);
}

// One fractional delay line, two pickups. The excitation overwrites every
// slot it will use before feedback begins.
static int16_t stringLine[256];
static uint8_t stringHead,stringAge;
static uint16_t excitationLeft,liveTap,noiseState=0xbeef;
static uint32_t excitationPhase,excitationInc;
static int16_t stringLast,stringInput,lastNoise;
static int8_t liveAllpass;
static uint8_t liveLength;
static bool stringActive;

static inline int16_t delayRead(uint16_t delay){
  uint8_t index=stringHead-(uint8_t)(delay>>8);
  int16_t a=stringLine[index],d=stringLine[(uint8_t)(index-1)]-a;
  return a+(((int32_t)d*(uint8_t)delay)>>8);
}

static void pluck(){
  liveTap=config.stringTap;
  liveAllpass=config.stringAllpass;
  liveLength=config.stringLength;
  excitationInc=config.inc[1];excitationPhase=0;
  excitationLeft=liveLength+1;
  stringHead=stringAge=0;stringLast=stringInput=0;stringActive=true;
}

static void stringTick(int16_t &a,int16_t &b){
  if(!stringActive)return;
  int16_t sample;
  if(excitationLeft){
    excitationLeft--;
    if(!(stringAge&1)){
      noiseState^=noiseState<<7;noiseState^=noiseState>>9;noiseState^=noiseState<<8;
      lastNoise=(int16_t)(noiseState&255)-128;
    }else lastNoise=-lastNoise;
    int16_t body=tableSample(SINE,excitationPhase>>16);
    excitationPhase+=excitationInc;
    sample=mix8(body,lastNoise,config.p1)*64;
    if(!stringAge)stringLast=stringInput=sample;
    if(stringAge<255)stringAge++;
  }else{
    // Fractional all-pass preserves sustain better than a linear delay tap.
    int16_t x=stringLine[(uint8_t)(stringHead-liveLength)];
    sample=stringInput+((((int32_t)(x-stringLast)*liveAllpass)+128)>>8);
    if(sample>8192)sample=8192;
    if(sample<-8192)sample=-8192;
    stringInput=x;
    int16_t diff=stringLast-sample;
    int16_t body=sample+(liveLength<16?(diff+32)>>6:(diff+8)>>4);
    stringLast=sample;
    int32_t product=(int32_t)body*config.stringGain;
    sample=(product<0?-((-product)>>15):product>>15);
  }
  a=sample/64;
  if(stringAge>(liveTap>>8)+1)b=delayRead(liveTap)/64;
  stringLine[stringHead++]=sample;
}

static inline uint8_t slew(uint8_t x,uint8_t y){
  return x<y?x+1:x>y?x-1:x;
}

static inline void resetPhases(){
  for(uint8_t i=0;i<5;i++)phase[i]=0;
  fmPrevious=0;
}

static void audioTick(){
  uint8_t m=config.model;
  if(m!=runningModel){
    runningModel=m;
    resetPhases();stringActive=false;p2Now=config.p2;p3Now=config.p3;
  }
  if(pendingSync){
    pendingSync=false;hits++;
    if(m==KARPLUS)pluck();
    else resetPhases();
  }
  if(!(frames&3)){p2Now=slew(p2Now,config.p2);p3Now=slew(p3Now,config.p3);}
  int16_t a=0,b=0;
  if(m!=KARPLUS)phase[0]+=config.inc[0];
  uint16_t root=phase[0]>>16;
  switch(m){
    case FOLD:{
      uint8_t x=root>>8;
      int16_t tri=x<config.p1?-63+(int16_t)(((uint16_t)x*config.foldRise)>>8)
        :63-(int16_t)(((uint16_t)(x-config.p1)*config.foldFall)>>8);
      b=tri*2;
      int16_t drive=tri+((tri*(int16_t)p2Now)>>5);
      int16_t first=fold(drive),second=fold(first*3);
      a=mix8(first,second,p3Now)*2;
      break;
    }
    case FM:{
      phase[1]+=config.inc[1];
      uint16_t modPhase=(phase[1]>>16)+fmPrevious*(int16_t)(p3Now>>1);
      b=tableSample(SINE,modPhase);fmPrevious=b;
      a=tableSample(SINE,(uint16_t)(root+b*(int16_t)p2Now));
      break;
    }
    case CHORD:{
      b=tableSample(SINE,root);
      const int8_t *color=config.table?config.table+((uint16_t)(p3Now>>2)<<6):SINE;
      for(uint8_t i=1;i<=4;i++){
        phase[i]+=config.inc[i];
        a+=tableSample(color,phase[i]>>16);
      }
      a/=4;
      break;
    }
    case WAVETABLE:
      a=scanTable(root,p2Now);b=scanTable(root,p3Now);
      break;
    case KARPLUS:
      stringTick(a,b);
      break;
  }
  writeDac(audioCode(0,boundSample(a)),audioCode(1,boundSample(b)));
  frames++;
}

#if defined(__AVR__)
ISR(TIMER1_COMPA_vect){audioTick();}
#endif

static uint16_t normalizeCv(int raw){
  int32_t v=((int32_t)raw-CV_IN_ADC_ZERO)*4095L/(CV_IN_ADC_PLUS5-CV_IN_ADC_ZERO);
  return v<0?0:v>4095?4095:v;
}

static uint32_t pitchStep(uint16_t q){
  uint8_t octave=q/3072,note=(q>>8)%12;
  uint32_t lo=pgm_read_dword(&PITCH[note]),hi=pgm_read_dword(&PITCH[note+1]);
  return (lo+(((hi-lo)*(q&255))>>8))<<octave;
}

static uint8_t bandFor(uint32_t step){
  // 12/6/3/1 partials, with a guard band below Nyquist.
  return step<143165577UL?0:step<286331153UL?1:step<572662306UL?2:3;
}

static uint8_t updateSector(uint16_t v,uint8_t previous,uint8_t count){
  uint8_t candidate=((uint16_t)(v*count))>>10;
  if(candidate>previous&&(v-5)*count>=(uint16_t)(previous+1)*1024)return candidate;
  if(candidate<previous&&(uint16_t)(v+5)*count<(uint16_t)previous*1024)return candidate;
  return previous;
}

static void selectModel(uint8_t next){
  model=next;
  sector1=((uint16_t)(pots[0]*(model==WAVETABLE?3:8)))>>10;
  sector2=pots[1]>>8;
}

static void publish(bool sync){
  AudioParams next={};
  uint16_t q=((uint32_t)pitchCv*15360)/4095;
  next.inc[0]=pitchStep(q);
  next.model=model;next.p1=pots[0]>>2;next.p2=pots[1]>>2;next.p3=pots[2]>>2;
  if(model==FOLD){
    uint8_t turn=64+(pots[0]>>3);next.p1=turn;
    next.foldRise=(126U*256U+turn/2)/turn;
    uint16_t fall=256-turn;next.foldFall=(126U*256U+fall/2)/fall;
  }else if(model==FM){
    sector1=updateSector(pots[0],sector1,8);
    uint8_t r=pgm_read_byte(FM_RATIOS_X2+sector1);
    uint32_t mod=(next.inc[0]>>1)*r;
    // Preserve an exact octave-related ratio when a modulator would alias.
    while(mod>1717986918UL)mod>>=1;
    next.inc[1]=mod;
  }else if(model==CHORD){
    sector1=updateSector(pots[0],sector1,8);
    sector2=updateSector(pots[1],sector2,4);
    uint32_t highest=next.inc[0];
    // Rotate the voicing without transposing the separate root on OUT2.
    for(uint8_t i=1;i<=4;i++){
      uint8_t note=(i-1+sector2)&3;
      uint8_t semitone=pgm_read_byte(&CHORDS[sector1][note]);
      if(note<sector2)semitone+=12;
      uint32_t inc=pitchStep(q+(uint16_t)semitone*256);
      next.inc[i]=inc;
      if(inc>highest)highest=inc;
    }
    uint8_t band=bandFor(highest);
    next.table=band<3?CHORD_COLOR[band][0]:nullptr;
  }else if(model==WAVETABLE){
    sector1=updateSector(pots[0],sector1,3);
    next.table=WAVES[sector1][bandFor(next.inc[0])][0];
    // End exactly at frame four, with three equal scan intervals.
    next.p2=((uint32_t)pots[1]*192+511)/1023;
    next.p3=((uint32_t)pots[2]*192+511)/1023;
  }else{
    uint16_t period=0x80000000UL/(next.inc[0]>>9);
    next.stringDelay=period-(period<16U*256U?4:16);
    int16_t fraction=(uint8_t)next.stringDelay;
    if(fraction<128)fraction+=256;
    next.stringAllpass=((256L-fraction)*256)/(256+fraction);
    next.stringLength=(next.stringDelay>>8)-(fraction>=256);
    next.inc[1]=0xffffffffUL/(next.stringLength+1);
    next.stringTap=((uint32_t)period*(32+(next.p3>>1)))>>8;
    if(next.stringTap<256)next.stringTap=256;
    uint16_t duration=140+(((uint32_t)next.p2*next.p2*2800)>>16);
    // Set the round-trip loss for a roughly pitch-independent decay time.
    uint32_t loss=((uint32_t)((next.stringDelay>>8)+1)*28294UL)/duration;
    next.stringGain=32768-(loss>24576?24576:loss);
  }
  ATOMIC_BLOCK(ATOMIC_RESTORESTATE){
    config=next;
    if(sync)pendingSync=true;
  }
}

static bool pressed(Button &b,bool raw,uint32_t now){
  if(raw!=b.raw){b.raw=raw;b.changed=now;}
  if(raw!=b.stable&&(uint32_t)(now-b.changed)>=25){
    b.stable=raw;return raw;
  }
  return false;
}

static void display(uint32_t now){
  uint8_t bits=1<<model;
  if(model==KARPLUS)bits=15;
  for(uint8_t i=0;i<4;i++)digitalWrite(PIN_LED1+i,(bits>>i)&1);
  if((uint32_t)(now-lastPitchMove)>=90)cvMoving=false;
  if((uint32_t)(now-lastHit)>=50)ioFlash=false;
  digitalWrite(PIN_CV_LED,cvMoving);
  digitalWrite(PIN_IO_LED,ioHigh||ioFlash);
}

void setup(){
  pinMode(PIN_IO,INPUT);digitalWrite(PIN_IO,LOW);pinMode(A5,INPUT);
  pinMode(PIN_MODE,INPUT);pinMode(PIN_MANUAL,INPUT);pinMode(PIN_CV,INPUT);
  pinMode(PIN_CV_LED,OUTPUT);pinMode(PIN_IO_LED,OUTPUT);
  for(uint8_t i=0;i<4;i++)pinMode(PIN_LED1+i,OUTPUT);
  pinMode(PIN_CS,OUTPUT);digitalWrite(PIN_CS,HIGH);SPI.begin();
  digitalWrite(PIN_LDAC,HIGH);pinMode(PIN_LDAC,OUTPUT);
  SPI.beginTransaction(SPISettings(8000000UL,MSBFIRST,SPI_MODE0));SPI.endTransaction();
  loadCalibration();writeDac(zeroCode[0],zeroCode[1]);
  for(uint8_t i=0;i<3;i++)pots[i]=analogRead(POTS[i]);
  pitchCv=normalizeCv(analogRead(PIN_CV));ioHigh=digitalRead(PIN_IO)==HIGH;
  lastControl=lastPot=millis();
  bool md=digitalRead(PIN_MODE)==HIGH,mn=digitalRead(PIN_MANUAL)==HIGH;
  modeButton={md,md,lastControl};manualButton={mn,mn,lastControl};
  selectModel(FOLD);publish(false);display(lastControl);
#if defined(__AVR__)
  ATOMIC_BLOCK(ATOMIC_RESTORESTATE){
    TCCR1A=0;TCCR1B=0;TCNT1=0;OCR1A=F_CPU/AUDIO_RATE-1;
    TIFR1=_BV(OCF1A);TIMSK1|=_BV(OCIE1A);TCCR1B=_BV(WGM12)|_BV(CS10);
  }
#endif
}

void loop(){
  uint32_t now=millis();
  bool high=digitalRead(PIN_IO)==HIGH,edge=high&&!ioHigh;ioHigh=high;
  bool change=pressed(modeButton,digitalRead(PIN_MODE)==HIGH,now);
  bool manual=pressed(manualButton,digitalRead(PIN_MANUAL)==HIGH,now);
  bool trigger=edge||manual;
  if(change)selectModel(model+1==MODEL_COUNT?FOLD:model+1);
  if((uint32_t)(now-lastPot)>=3){
    lastPot=now;
    uint16_t raw=analogRead(POTS[potSlot]);
    if(abs((int16_t)raw-(int16_t)pots[potSlot])>=3||raw==0||raw==1023)pots[potSlot]=raw;
    if(++potSlot==3)potSlot=0;
  }
  if(trigger||change||(uint32_t)(now-lastControl)>=2){
    lastControl=now;uint16_t value=normalizeCv(analogRead(PIN_CV));
    if(abs((int16_t)value-(int16_t)pitchCv)>=8){cvMoving=true;lastPitchMove=now;}
    pitchCv=value;
    if(trigger){ioFlash=true;lastHit=now;}
    publish(trigger);
    display(now);
  }
}
